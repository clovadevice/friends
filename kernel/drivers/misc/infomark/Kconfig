## kernel/drivers/misc/infomark/Kconfig
```kconfig
config CLOVA_MODELNAME
    bool "CLOVA_MODELNAME"

config IS3236A_LED_DRIVER
    bool "ISSI IS31FL3236A LED DRIVER"
    depends on I2C
    select INFOMARK_LED_ANIMATION

config IS3737_LED_DRIVER
    bool "ISSI IS31FL3737 LED DRIVER"
    depends on I2C
    select INFOMARK_LED_ANIMATION

config LP5569_LED_DRIVER
    bool "TI LP5569 LED DRIVER"
    depends on I2C
    select INFOMARK_LED_ANIMATION

config INFOMARK_LED_ANIMATION
    bool "INFOMARK LED ANIMATION"

config INFOMARK_GPIO_LED_DRIVER
    bool "INFOMARK GPIO LED DRIVER"
```

## kernel/sound/soc/codecs/realtek/Kconfig
```kconfig
menuconfig SND_SOC_REALTEK
	tristate "Realtek Audio Driver"

config SND_SOC_RT5640
    bool "Codec Driver support"

	
```

## kernel/sound/soc/codecs/ti/Kconfig
```kconfig
menuconfig SND_SOC_TAS2559
	tristate "Texas Instruments TAS2559 SmartAmp(R)"

if SND_SOC_TAS2559
config TAS2559_CODEC
    bool "Codec Driver support"

config TAS2559_MISC
    bool "Misc Driver support"
	
endif # SND_SOC_TAS2559
```
